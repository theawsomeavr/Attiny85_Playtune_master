

#define DBUG 0

#include <avr/io.h>
#include <avr/interrupt.h>
#include <avr/pgmspace.h>

#define WDTCSR WDTCR	// There's a typo in the AtmelStudio iotn4313.h file!

#define NUM_CHANS 3	// number of speaker outputs

#define CPU_MHZ	8		// ATtiny CKSEL 0100: 8 Mhz, 1x prescale (lfuse=E4)

/*  Menorah I/O port assignments */

#define SPEAKER0 PB0  // output, speaker 1 (also USB-TTL RX)
#define SPEAKER1 PB1  // output, speaker 2 (also USB-TTL TX)


#define SPEAKER2 PB2 // output, speaker 1 (was input, option jumper 2)
  // output, speaker 3 (was input, option jumper 1)
//               PA2  // input, USB reset




#define PORT(x)	_SFR_IO8(x)


// speaker registers
// We use constants for speaker ports because we don't want any overhead
// in the interrupt routines; the loop through the speakers there is unrolled.

#define SPEAKER0_REG PORTB	//  data register
#define SPEAKER0_DIR DDRB	//  direction register

#define SPEAKER1_REG PORTB	//  data register
#define SPEAKER1_DIR DDRB	//  direction register

#define SPEAKER2_REG PORTB	//  data register
#define SPEAKER2_DIR DDRB	//  direction register

	//  direction register

typedef uint8_t byte;
typedef uint8_t boolean;
#define false 0
#define true 1
#define noInterrupts cli
#define Interrupts sei

// variable for timing

volatile unsigned int scorewait_interrupt_count;
volatile unsigned int delaywait_interrupt_count;

// variables for music-playing

volatile byte *score_start;
volatile byte *score_cursor;
volatile boolean tune_playing;

volatile long accumulator [NUM_CHANS];
volatile long decrement [NUM_CHANS];
volatile boolean playing [NUM_CHANS];

/* Table of accumulator decrement values, generated by a companion Excel spreadsheet.
   These depend on the polling frequency and the accumulator restart value.
   We basically do incremental division for each channel in the polling interrupt routine:
        accum -= decrement
        if (accum < 0) {
            toggle speaker output
            accum += ACCUM_RESTART
        }
*/

#define POLLTIME_USEC 50		// polling interval in microseconds
#define ACCUM_RESTART 4194304L	// 2^22 allows 1-byte addition on 3- or 4-byte numbers
#define MAX_NOTE 123

const long decrement_PGM[MAX_NOTE+1] PROGMEM = {
    3429L, 3633L, 3849L, 4078L, 4320L, 4577L, 4850L, 5138L, 5443L, 5767L, 6110L, 6473L, 
    6858L, 7266L, 7698L, 8156L, 8641L, 9155L, 9699L, 10276L, 10887L, 11534L, 12220L, 
    12947L, 13717L, 14532L, 15396L, 16312L, 17282L, 18310L, 19398L, 20552L, 21774L, 
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    2630637L, 2787063L, 2952790L, 3128372L, 3314395L, 3511479L, 3720282L, 3941502L, 
    4175876L
};

void tune_playnote (byte chan, byte note);
void tune_stopnote (byte chan);
void tune_stepscore (void);


//--------------------------------------------------------------------------
// Initialize the timers
//--------------------------------------------------------------------------

void init_timers () {
    
    // We use the 8 bit timer to generate the polling interrupt for notes.
    // It should interrupt often, like every 50 microseconds.
    
    TCCR0A = (1 << WGM01);	// mode 010: CTC   
#if CPU_MHZ==4
    TCCR0B = 1 << CS00;		// clock select 001: no prescaling
    OCR0A = CPU_MHZ * POLLTIME_USEC;
#elif CPU_MHZ==8
    TCCR0B = 1 << CS01;		// clock select 010: clk/8 prescaling
    OCR0A = CPU_MHZ/8 * POLLTIME_USEC;
#else
 unusual frequency
#endif
    
    // We use the 16 bit timer both for timing scores from the interrupt routine
    // and doing mainline code waits. It interrupts once a millisecond.
    
      TCCR1 |= (1 << CTC1);  // clear timer on compare match
     // TCCR1 |= (1 << CS10);
	  TCCR1 |= (1 << CS13);  // clear timer on compare match
	 // TCCR1 |= (1 << CS11);
    OCR1C = CPU_MHZ * 1000;

    tune_playing = false;    
    scorewait_interrupt_count = 0;
    delaywait_interrupt_count = 0;
    
    TIMSK =(1<<OCIE0A) | (1<<OCIE1A); // turn on match A interrupts for both timers
    Interrupts();		 // enable interrupts

}


//--------------------------------------------------------------------------
// Start playing a note on a particular channel
//--------------------------------------------------------------------------

void tune_playnote (byte chan, byte note) {

    if (chan < NUM_CHANS) {
        if (note>MAX_NOTE) note=MAX_NOTE;
        decrement[chan] = pgm_read_dword(decrement_PGM + note);
        accumulator[chan] = ACCUM_RESTART;
        playing[chan]=true;
    }
}


//--------------------------------------------------------------------------
// Stop playing a note on a particular channel
//--------------------------------------------------------------------------

void tune_stopnote (byte chan) {
    playing[chan]= false;
}


//--------------------------------------------------------------------------
//   Play a score
//--------------------------------------------------------------------------

void tune_stopscore();

void tune_playscore (byte *score) {
    if (tune_playing) tune_stopscore();
    score_start = score;
    score_cursor = score;
    tune_stepscore();	/* execute initial commands */
    tune_playing = true;  /* release the interrupt routine */
}

/* Do score commands until a "wait" is found, or the score is stopped.
 This is called initially from tune_playcore, but then is called
 from the interrupt routine when waits expire.
 */

#define CMD_PLAYNOTE	0x90	/* play a note: low nibble is generator #, note is next byte */
#define CMD_STOPNOTE	0x80	/* stop a note: low nibble is generator # */
#define CMD_RESTART		0xe0	/* restart the score from the beginning */
#define CMD_STOP		0xf0	/* stop playing */
/* if CMD < 0x80, then the other 7 bits and the next byte are a 15-bit big-endian number of msec to wait */

void tune_stepscore (void) {
  byte cmd, opcode, chan;

  while (1) {
    cmd = pgm_read_byte(score_cursor++);
    if (cmd < 0x80) {
      /* wait count is in msec. */
      scorewait_interrupt_count = ((unsigned)cmd << 8) | (pgm_read_byte(score_cursor++));
      break;
    }
    opcode = cmd & 0xf0;
    chan = cmd & 0x0f;
    if (opcode == CMD_STOPNOTE) {
      /* stop note */
      tune_stopnote (chan);
    }
    else if (opcode == CMD_PLAYNOTE) {
      /* play note */
      tune_playnote (chan, pgm_read_byte(score_cursor++));
    }
    else if (opcode == CMD_RESTART) {
      /* restart score */
      score_cursor = score_start;
    }
    else if (opcode == CMD_STOP) {
      /* stop score */
      tune_playing = false;
      break;
    }
  }
}

//--------------------------------------------------------------------------
// Stop playing a score
//--------------------------------------------------------------------------

void tune_stopscore (void) {
  tune_stopnote(0);
  tune_stopnote(1);
  tune_stopnote(2);
  // depends on NUM_CHANS==4
  tune_playing = false;
}

//--------------------------------------------------------------------------
// Delay a specified number of milliseconds, up to about 30 seconds.
//--------------------------------------------------------------------------

void tune_delay (unsigned duration) {
    boolean notdone;
    
    delaywait_interrupt_count = duration;
    do {
        // wait until the interrupt routines decrements the toggle count to zero
        noInterrupts();
        notdone = delaywait_interrupt_count != 0;  /* interrupt-safe test */
        Interrupts();
    }  while (notdone);
}

//--------------------------------------------------------------------------
// Stop all channels
//--------------------------------------------------------------------------

void tune_stopchans(void) {

  TIMSK &= ~(1 << OCIE0A);  // disable all timer interrupts
  TIMSK &= ~(1 << OCIE1A);
}

//--------------------------------------------------------------------------
//  Timer interrupt Service Routines
//--------------------------------------------------------------------------

ISR(TIMER0_COMPA_vect) { //******* 8-bit timer: 50 microsecond interrupts
    
// We unroll code with a macro to avoid loop overhead.
// For even greater efficiency, we could write this in assembly code
// and do 3-byte instead of 4-byte arithmetic.

  #define dospeaker(spkr) if (playing[spkr]) {	 \
      accumulator[spkr] -= decrement[spkr];		 \
  if (accumulator[spkr]<0) {					 \
      SPEAKER##spkr##_REG ^= (1<<SPEAKER##spkr); \
      accumulator[spkr] += ACCUM_RESTART;		 \
    }											 \
  }	
  
  dospeaker(0);
  dospeaker(1);
  dospeaker(2);
   // Depends on NUM_CHANS==4
}

ISR(TIMER1_COMPA_vect) { //******* 16-bit timer: millisecond interrupts
    
    // decrement score wait counter
    if (tune_playing && scorewait_interrupt_count && --scorewait_interrupt_count == 0) {
        // end of a score wait, so execute more score commands
        tune_stepscore ();  // execute commands
    }
    
    // decrement delay wait counter
    if (delaywait_interrupt_count)
    --delaywait_interrupt_count;	// countdown for tune_delay()
}

//-----------------------------------------------------------------------------------------------------
// The music we play, generated by "miditones" from MIDI files.
//-----------------------------------------------------------------------------------------------------



/// Playtune bytestream for file "maoz_4chan.mid" created by MIDITONES V1.6 on Mon Nov 25 14:36:59 2013
// command line: c:\data\projects\midi\miditones\lcc\miditones maoz_4chan
const byte PROGMEM score [] = {
0x90,0x58, 0,204, 0x80, 0,204, 0x90,0x47, 0x91,0x4C, 0,204, 0x80, 0x81, 0x90,0x53, 0,204, 0x80, 1,152,
0x90,0x47, 0x91,0x4C, 0,204, 0x80, 0x81, 0x90,0x51, 0,204, 0x80, 0x90,0x4F, 0,204, 0x80, 0x90,0x51, 0,204,
0x80, 0x90,0x47, 0x91,0x4C, 0,204, 0x81, 0x80, 0x90,0x53, 0,204, 0x80, 0,204, 0x90,0x4F, 0,204, 0x80,
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0x80, 0x90,0x28, 0x91,0x4C, 7,40, 0x81, 0,4, 0x80, 0xf0};



//-----------------------------------------------------------------------------------------------------
//                    **************   main logic   ***********************
//-----------------------------------------------------------------------------------------------------

int main (void) {
  
    
    // Clear watchdog timer-- this can prevent several things from going wrong.
 	//Disable sleep mode

    init_timers();      // initialize both timers, for music and for delays
    
    // configure I/O ports


    DDRB = (1<<SPEAKER0)+(1<<SPEAKER1)+(1<<SPEAKER2);    
    PORTB = 0;
       // pushbutton has a pullup
    //tune_playnote(0,70);

    tune_playscore (score);	
	    while (tune_playing) {
	
			    //tune_stopscore();
			 
		    }
}
